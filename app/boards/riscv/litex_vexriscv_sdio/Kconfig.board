## app/boards/riscv/litex_vexriscv_sdio/Kconfig.board
```kconfig
# SPDX-License-Identifier: Apache-2.0
#
# LiteX VexRiscv with SDIO Controller Board Configuration
#

config BOARD_LITEX_VEXRISCV_SDIO
	bool "LiteX VexRiscv SoC with SDIO controller on Tang Primer 20K"
	depends on SOC_RISCV32_LITEX_VEXRISCV
	help
	  LiteX VexRiscv SoC with custom SDIO host controller.
	  This board targets the Sipeed Tang Primer 20K FPGA with:
	  - VexRiscv RV32IM CPU at 48 MHz
	  - 8 KB SRAM
	  - 128 KB Flash/ROM
	  - Custom SDIO controller at 0x80000000
	  - UART console
	  - System timer
```

## app/boards/riscv/litex_vexriscv_sdio/Kconfig.defconfig
```kconfig
# SPDX-License-Identifier: Apache-2.0
#
# LiteX VexRiscv SDIO Board Default Configuration
#

if BOARD_LITEX_VEXRISCV_SDIO

config BOARD
	default "litex_vexriscv_sdio"

# SoC configuration
config SOC
	default "vexriscv"

# CPU configuration
config SYS_CLOCK_HW_CYCLES_PER_SEC
	default 48000000

# Console configuration
if SERIAL

config UART_CONSOLE
	default y

endif # SERIAL

# Timer configuration
if RISCV_MACHINE_TIMER

config RISCV_MACHINE_TIMER_SYSTEM_CLOCK_DIVIDER
	default 1

endif # RISCV_MACHINE_TIMER

endif # BOARD_LITEX_VEXRISCV_SDIO
```

## app/boards/riscv/litex_vexriscv_sdio/board.yml
```yaml
# SPDX-License-Identifier: Apache-2.0

board:
  name: litex_vexriscv_sdio
  vendor: litex
  arch: riscv
  socs:
    - name: vexriscv
      variants:
        - name: standard
  ram: 8
  flash: 128
```

## app/boards/riscv/litex_vexriscv_sdio/litex_vexriscv_sdio_defconfig
```kconfig
# SPDX-License-Identifier: Apache-2.0
#
# Default Configuration for LiteX VexRiscv SDIO Board
#

CONFIG_BOARD_LITEX_VEXRISCV_SDIO=y
CONFIG_SOC_RISCV32_LITEX_VEXRISCV=y

# CPU Configuration
CONFIG_RISCV=y
CONFIG_RISCV_ISA_RV32I=y
CONFIG_RISCV_ISA_EXT_M=y

# Console
CONFIG_CONSOLE=y
CONFIG_UART_CONSOLE=y
CONFIG_SERIAL=y

# Printk
CONFIG_PRINTK=y
CONFIG_EARLY_CONSOLE=y

# Timing
CONFIG_RISCV_MACHINE_TIMER=y

# Memory
CONFIG_HEAP_MEM_POOL_SIZE=4096
CONFIG_MAIN_STACK_SIZE=2048
```
